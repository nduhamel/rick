## Config.in
```kconfig
source "$BR2_EXTERNAL_RICK_PATH/package/librespot/Config.in"
source "$BR2_EXTERNAL_RICK_PATH/package/python-aiohttp/Config.in"
source "$BR2_EXTERNAL_RICK_PATH/package/python-astral/Config.in"
source "$BR2_EXTERNAL_RICK_PATH/package/python-async_timeout/Config.in"
source "$BR2_EXTERNAL_RICK_PATH/package/python-idna-ssl/Config.in"
source "$BR2_EXTERNAL_RICK_PATH/package/python-typing/Config.in"
source "$BR2_EXTERNAL_RICK_PATH/package/python-voluptuous/Config.in"
source "$BR2_EXTERNAL_RICK_PATH/package/python-yarl/Config.in"
source "$BR2_EXTERNAL_RICK_PATH/package/python-pip/Config.in"
source "$BR2_EXTERNAL_RICK_PATH/package/python-homeassistant/Config.in"
source "$BR2_EXTERNAL_RICK_PATH/package/python-multidict/Config.in"
source "$BR2_EXTERNAL_RICK_PATH/package/python-wheel/Config.in"
source "$BR2_EXTERNAL_RICK_PATH/package/python-aiohttp_cors/Config.in"
source "$BR2_EXTERNAL_RICK_PATH/package/python-ua-parser/Config.in"
source "$BR2_EXTERNAL_RICK_PATH/package/python-user-agents/Config.in"
source "$BR2_EXTERNAL_RICK_PATH/package/python-home-assistant-frontend/Config.in"
source "$BR2_EXTERNAL_RICK_PATH/package/python-netdisco/Config.in"
source "$BR2_EXTERNAL_RICK_PATH/package/python-zeroconf/Config.in"
```

## configs/rick_common_defconfig
```kconfig
BR2_TOOLCHAIN_BUILDROOT_GLIBC=y
BR2_TOOLCHAIN_BUILDROOT_CXX=y

BR2_TARGET_GENERIC_HOSTNAME="a20-olinuxino"
BR2_TARGET_GENERIC_ISSUE="Welcome to OLinuXino!"
BR2_TARGET_GENERIC_PASSWD_SHA512=y
BR2_INIT_SYSTEMD=y
BR2_TARGET_GENERIC_ROOT_PASSWD="droopy"
BR2_SYSTEM_BIN_SH_ZSH=y

BR2_ROOTFS_OVERLAY="$(BR2_EXTERNAL_RICK_PATH)/rootfs_overlay"

BR2_PACKAGE_PYTHON3=y
BR2_PACKAGE_PYTHON3_SQLITE=y
BR2_PACKAGE_PORTAUDIO=y
BR2_PACKAGE_LIBCURL=y
BR2_PACKAGE_CURL=y
BR2_PACKAGE_IPROUTE2=y
BR2_PACKAGE_OPENSSH=y
BR2_PACKAGE_WGET=y
BR2_PACKAGE_VIM=y
BR2_TARGET_ROOTFS_EXT2=y
BR2_TARGET_ROOTFS_EXT2_4=y
BR2_TARGET_ROOTFS_EXT2_SIZE="300M"

BR2_PACKAGE_HOST_RUSTC=y
BR2_PACKAGE_LIBRESPOT=y
BR2_PACKAGE_PYTHON_HOMEASSISTANT=y
BR2_PACKAGE_PYTHON_WHEEL=y
BR2_PACKAGE_SNAPCAST=y
# BR2_PACKAGE_SNAPCAST_CLIENT is not set
BR2_PACKAGE_SNAPCAST_SERVER=y
```

## configs/rick_defconfig
```kconfig
BR2_arm=y
BR2_cortex_a7=y

BR2_PACKAGE_HOST_LINUX_HEADERS_CUSTOM_4_14=y
BR2_TARGET_GENERIC_GETTY_PORT="ttyS0"
BR2_ROOTFS_POST_BUILD_SCRIPT="board/olimex/a20_olinuxino/post-build.sh"
BR2_ROOTFS_POST_IMAGE_SCRIPT="support/scripts/genimage.sh"
BR2_ROOTFS_POST_SCRIPT_ARGS="-c board/olimex/a20_olinuxino/genimage.cfg"

BR2_LINUX_KERNEL_DEFCONFIG="sunxi"
BR2_LINUX_KERNEL_DTS_SUPPORT=y
BR2_LINUX_KERNEL_INTREE_DTS_NAME="sun7i-a20-olinuxino-lime2"
BR2_LINUX_KERNEL_CUSTOM_VERSION_VALUE="4.14.26"
BR2_LINUX_KERNEL_INSTALL_TARGET=y

# BR2_TARGET_ROOTFS_TAR is not set
BR2_TARGET_UBOOT=y
BR2_TARGET_UBOOT_BUILD_SYSTEM_KCONFIG=y
BR2_TARGET_UBOOT_CUSTOM_VERSION=y
BR2_TARGET_UBOOT_CUSTOM_VERSION_VALUE="2018.03"
BR2_TARGET_UBOOT_BOARD_DEFCONFIG="A20-OLinuXino-Lime2"
BR2_TARGET_UBOOT_NEEDS_DTC=y
BR2_TARGET_UBOOT_NEEDS_PYLIBFDT=y
BR2_TARGET_UBOOT_SPL=y
BR2_TARGET_UBOOT_SPL_NAME="u-boot-sunxi-with-spl.bin"
BR2_TARGET_UBOOT_BOOT_SCRIPT=y
BR2_TARGET_UBOOT_BOOT_SCRIPT_SOURCE="board/olimex/a20_olinuxino/boot.cmd"
BR2_PACKAGE_HOST_GENIMAGE=y
```

## configs/rick_qemu_defconfig
```kconfig
BR2_arm=y
BR2_cortex_a9=y
BR2_ARM_ENABLE_NEON=y
BR2_ARM_ENABLE_VFP=y
BR2_PACKAGE_HOST_LINUX_HEADERS_CUSTOM_4_11=y
BR2_TARGET_GENERIC_GETTY_PORT="ttyAMA0"
BR2_SYSTEM_DHCP="eth0"
BR2_LINUX_KERNEL=y
BR2_LINUX_KERNEL_CUSTOM_VERSION=y
BR2_LINUX_KERNEL_CUSTOM_VERSION_VALUE="4.11.3"
BR2_LINUX_KERNEL_DEFCONFIG="vexpress"
BR2_LINUX_KERNEL_DTS_SUPPORT=y
BR2_LINUX_KERNEL_INTREE_DTS_NAME="vexpress-v2p-ca9"
```

## package/librespot/Config.in
```kconfig
config BR2_PACKAGE_LIBRESPOT
    bool "Librespot"
    depends on BR2_PACKAGE_HOST_RUSTC_ARCH_SUPPORTS
    select BR2_PACKAGE_HOST_CARGO
```

## package/python-aiohttp/Config.in
```kconfig
config BR2_PACKAGE_PYTHON_AIOHTTP
	bool "python-aiohttp"
	select BR2_PACKAGE_PYTHON_ATTRS # runtime
	select BR2_PACKAGE_PYTHON_CHARDET # runtime
	select BR2_PACKAGE_PYTHON_MULTIDICT # runtime
	select BR2_PACKAGE_PYTHON_ASYNC_TIMEOUT # runtime
	select BR2_PACKAGE_PYTHON_YARL # runtime
	select BR2_PACKAGE_PYTHON_IDNA_SSL # runtime
	help
	  Async http client/server framework (asyncio).

	  https://github.com/aio-libs/aiohttp/
```

## package/python-aiohttp_cors/Config.in
```kconfig
config BR2_PACKAGE_PYTHON_AIOHTTP_CORS
	bool "python-aiohttp_cors"
	select BR2_PACKAGE_PYTHON_AIOHTTP # runtime
	select BR2_PACKAGE_PYTHON_TYPING # runtime
	help
	  CORS support for aiohttp.

	  https://github.com/aio-libs/aiohttp-cors
```

## package/python-astral/Config.in
```kconfig
config BR2_PACKAGE_PYTHON_ASTRAL
	bool "python-astral"
	select BR2_PACKAGE_PYTHON_PYTZ # runtime
	select BR2_PACKAGE_PYTHON_REQUESTS # runtime
	help
	  Calculations for the position of the sun and moon.

	  https://github.com/sffjunkie/astral
```

## package/python-async_timeout/Config.in
```kconfig
config BR2_PACKAGE_PYTHON_ASYNC_TIMEOUT
	bool "python-async_timeout"
	help
	  Timeout context manager for asyncio programs.

	  https://github.com/aio-libs/async_timeout/
```

## package/python-home-assistant-frontend/Config.in
```kconfig
config BR2_PACKAGE_PYTHON_HOME_ASSISTANT_FRONTEND
	bool "python-home-assistant-frontend"
	select BR2_PACKAGE_PYTHON_USER_AGENTS # runtime
	help
	  The Home Assistant frontend.

	  https://github.com/home-assistant/home-assistant-polymer
```

## package/python-homeassistant/Config.in
```kconfig
config BR2_PACKAGE_PYTHON_HOMEASSISTANT
	bool "python-homeassistant"
	select BR2_PACKAGE_PYTHON_REQUESTS # runtime
	select BR2_PACKAGE_PYTHON_PYYAML # runtime
	select BR2_PACKAGE_PYTHON_PYTZ # runtime
	select BR2_PACKAGE_PYTHON_PIP # runtime
	select BR2_PACKAGE_PYTHON_JINJA2 # runtime
	select BR2_PACKAGE_PYTHON_VOLUPTUOUS # runtime
	select BR2_PACKAGE_PYTHON_TYPING # runtime
	select BR2_PACKAGE_PYTHON_AIOHTTP # runtime
	select BR2_PACKAGE_PYTHON_ASYNC_TIMEOUT # runtime
	select BR2_PACKAGE_PYTHON_ASTRAL # runtime
	select BR2_PACKAGE_PYTHON_CERTIFI # runtime
	select BR2_PACKAGE_PYTHON_ATTRS # runtime
	select BR2_PACKAGE_PYTHON_XMLTODICT # runtime
	select BR2_PACKAGE_PYTHON_AIOHTTP_CORS # runtime
	select BR2_PACKAGE_PYTHON_HOME_ASSISTANT_FRONTEND # runtime
	select BR2_PACKAGE_PYTHON_NETDISCO # runtime
	help
	  Open-source home automation platform running on Python 3.

	  https://home-assistant.io/
```

## package/python-idna-ssl/Config.in
```kconfig
config BR2_PACKAGE_PYTHON_IDNA_SSL
	bool "python-idna-ssl"
	select BR2_PACKAGE_PYTHON_IDNA # runtime
	help
	  Patch ssl.match_hostname for Unicode(idna) domains support.

	  https://github.com/aio-libs/idna-ssl
```

## package/python-multidict/Config.in
```kconfig
config BR2_PACKAGE_PYTHON_MULTIDICT
	bool "python-multidict"
	help
	  multidict implementation.

	  https://github.com/aio-libs/multidict/
```

## package/python-netdisco/Config.in
```kconfig
config BR2_PACKAGE_PYTHON_NETDISCO
	bool "python-netdisco"
	select BR2_PACKAGE_PYTHON_REQUESTS # runtime
	select BR2_PACKAGE_PYTHON_ZEROCONF # runtime
	help
	  Discover devices on your local network.

	  https://github.com/home-assistant/netdisco
```

## package/python-ua-parser/Config.in
```kconfig
config BR2_PACKAGE_PYTHON_UA_PARSER
	bool "python-ua-parser"
        select BR2_PACKAGE_HOST_PYTHON_PYYAML
	help
	  Python port of Browserscope's user agent parser.

	  https://github.com/ua-parser/uap-python
```

## package/python-yarl/Config.in
```kconfig
config BR2_PACKAGE_PYTHON_YARL
	bool "python-yarl"
	select BR2_PACKAGE_PYTHON_MULTIDICT # runtime
	select BR2_PACKAGE_PYTHON_IDNA # runtime
	help
	  Yet another URL library.

	  https://github.com/aio-libs/yarl/
```
